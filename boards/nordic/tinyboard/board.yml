## boards/nordic/tinyboard/board.yml
```yaml
board:
  name: tinyboard 
  full_name: Tiny Board
  vendor: nordic
  socs:
  - name: nrf54l15
    variants:
    - name: xip
      cpucluster: cpuflpr
    - name: ns
      cpucluster: cpuapp
```
